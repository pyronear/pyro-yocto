## conf/distro/pyronear-os.conf
```bitbake
require conf/distro/poky.conf

DISTRO = "pyronear-os"
DISTRO_NAME = "PyroNear OS"
DISTRO_VERSION = "1.0"

# --- INIT MANAGER ---
INIT_MANAGER = "systemd"

# --- DISTRO & MACHINE FEATURES ---
DISTRO_FEATURES:append = " virtualization"
DISTRO_FEATURES:remove = " x11 wayland opengl vulkan alsa bluetooth nfc pcmcia ptest debuginfod zeroconf nfs usbgadget multiarch"
MACHINE_FEATURES:remove = " screen touchscreen alsa bluetooth"

# --- LICENCES & CONSOLES ---
LICENSE_FLAGS_ACCEPTED = "synaptics-killswitch"
SERIAL_CONSOLES = "115200;ttyAMA0"

# --- HARDWARE & RASPBERRY PI TWEAKS ---
# Bien que liés au hardware, ces réglages sont fixes pour ton projet
ENABLE_UART = "1"
RPI_EXTRA_CONFIG:append = "\ndtoverlay=uart0-pi5\n"
KERNEL_MODULE_AUTOLOAD += "zram"

# --- OPTIMISATION DES PAQUETS ---
PACKAGECONFIG:pn-curl = "basic-auth bearer-auth openssl random threaded-resolver zlib"
PACKAGECONFIG:pn-jq = ""
PACKAGECONFIG:pn-parted = ""
BAD_RECOMMENDATIONS += "udev-hwdb file"

# --- RAUC HAWKBIT ---
# DISTRO_FEATURES:append = " rauc"
# RPI_USE_U_BOOT = "1"
# RAUC_BUNDLE_COMPATIBLE = "raspberrypi5"
# RAUC_KEY_FILE = "/chemin/vers/tes/cles/rauc.key.pem"
# RAUC_CERT_FILE = "/chemin/vers/tes/cles/rauc.cert.pem"
```

## local-layers/meta-pyronear/conf/distro/pyronear-os.conf
```bitbake
require conf/distro/poky.conf

DISTRO = "pyronear-os"
DISTRO_NAME = "PyroNear OS"
DISTRO_VERSION = "1.0"

# Disable all default DISTRO_FEATURES
DISTRO_FEATURES_OPTED_OUT = "*"

# Distro features required by the Pyronear environment
DISTRO_FEATURES:append = " \
    wifi \
    ipv6 \
    \
    virtualization \
    seccomp \
    \
    overlayfs \
    rauc \
"

INIT_MANAGER = "systemd"
```
